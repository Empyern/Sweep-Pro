## config/west.yml
```yaml
manifest:
  remotes:
  - name: zmkfirmware
#    url-base: https://github.com/zmkfirmware
  url-base: https://github.com/xudongzheng
  projects:
  - name: zmk
    remote: zmkfirmware
    revision: bt-no-profile-pr
    import: app/west.yml
  self:
    path: config
```
